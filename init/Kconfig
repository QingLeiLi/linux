## mm/Kconfig.debug
```kconfig
# SPDX-License-Identifier: GPL-2.0-only
# 内存管理调试能力菜单片段：多数选项只编译检测基础设施，是否在启动或运行期
# 真正启用还受命令行/sysfs/debugfs 控制。depends on 描述安全前置条件，select
# 补齐元数据、栈仓库或页表转储等实现依赖。
config PAGE_EXTENSION
# 为每个 struct page 关联按需扩展区，供 page owner、idle 标志、页表检查等功能
# 存放额外状态；扩展区可按启动配置分配，避免永久扩大所有 struct page。
	bool "Extend memmap on extra space for more information on page"
	help
	  Extend memmap on extra space for more information on page. This
	  could be used for debugging features that need to insert extra
	  field for every page. This extension enables us to save memory
	  by not allocating this extra memory according to boottime
	  configuration.

config DEBUG_PAGEALLOC
# 释放页后从 linear map 解除映射，或在不支持的架构上退化为 poison 填充；分配
# 前同步检查页状态，可捕获 UAF/double-free，但会破坏大页映射并显著拖慢系统。
# hibernation 若不保存 free page 会在恢复后产生伪损坏，因此受架构条件限制。
	bool "Debug page memory allocations"
	depends on DEBUG_KERNEL
	depends on !HIBERNATION || ARCH_SUPPORTS_DEBUG_PAGEALLOC && !PPC && !SPARC
	select PAGE_POISONING if !ARCH_SUPPORTS_DEBUG_PAGEALLOC
	help
	  Unmap pages from the kernel linear mapping after free_pages().
	  Depending on runtime enablement, this results in a small or large
	  slowdown, but helps to find certain types of memory corruption.

	  Also, the state of page tracking structures is checked more often as
	  pages are being allocated and freed, as unexpected state changes
	  often happen for same reasons as memory corruption (e.g. double free,
	  use-after-free). The error reports for these checks can be augmented
	  with stack traces of last allocation and freeing of the page, when
	  PAGE_OWNER is also selected and enabled on boot.

	  For architectures which don't enable ARCH_SUPPORTS_DEBUG_PAGEALLOC,
	  fill the pages with poison patterns after free_pages() and verify
	  the patterns before alloc_pages(). Additionally, this option cannot
	  be enabled in combination with hibernation as that would result in
	  incorrect warnings of memory corruption after a resume because free
	  pages are not saved to the suspend image.

	  By default this option will have a small overhead, e.g. by not
	  allowing the kernel mapping to be backed by large pages on some
	  architectures. Even bigger overhead comes when the debugging is
	  enabled by DEBUG_PAGEALLOC_ENABLE_DEFAULT or the debug_pagealloc
	  command line parameter.

config DEBUG_PAGEALLOC_ENABLE_DEFAULT
# 只把 debug pagealloc 的运行期默认值设为 on；debug_pagealloc=off|on 可覆盖。
	bool "Enable debug page memory allocations by default?"
	depends on DEBUG_PAGEALLOC
	help
	  Enable debug page memory allocations by default? This value
	  can be overridden by debug_pagealloc=off|on.

config SLUB_DEBUG
# 编译 SLUB 校验、追踪与 sysfs 控制能力；默认构建但通常运行期关闭，关闭本项
# 可节省代码，SLUB_TINY 则因元数据预算直接排除。
	default y
	bool "Enable SLUB debugging support" if EXPERT
	depends on SYSFS && !SLUB_TINY
	select STACKDEPOT if STACKTRACE_SUPPORT
	help
	  SLUB has extensive debug support features. Disabling these can
	  result in significant savings in code size. While /sys/kernel/slab
	  will still exist (with SYSFS enabled), it will not provide e.g. cache
	  validation.

config SLUB_DEBUG_ON
# 启动即打开通用 SLUB 调试，近似 slab_debug 无细分参数；仍可用 slab_debug=-
# 关闭。栈追踪架构还要求 STACKDEPOT 在更早阶段初始化。
	bool "SLUB debugging on by default"
	depends on SLUB_DEBUG
	select STACKDEPOT_ALWAYS_INIT if STACKTRACE_SUPPORT
	default n
	help
	  Boot with debugging on by default. SLUB boots by default with
	  the runtime debug capabilities switched off. Enabling this is
	  equivalent to specifying the "slab_debug" parameter on boot.
	  There is no support for more fine grained debug control like
	  possible with slab_debug=xxx. SLUB debugging may be switched
	  off in a kernel built with CONFIG_SLUB_DEBUG_ON by specifying
	  "slab_debug=-".

config SLUB_RCU_DEBUG
# 把 SLAB_TYPESAFE_BY_RCU 对象的复用延后得近似 kfree_rcu，使 KASAN 能观察
# grace period 内 UAF；这会改变某类“对象在宽限期内被复用”的 bug 时序。
	bool "Enable UAF detection in TYPESAFE_BY_RCU caches (for KASAN)"
	depends on SLUB_DEBUG
	# SLUB_RCU_DEBUG should build fine without KASAN, but is currently useless
	# without KASAN, so mark it as a dependency of KASAN for now.
	# 该代码理论上无需 KASAN 也能编译，但当前只有 KASAN 消费其检测效果，所以
	# 暂把 KASAN 作为依赖；这是用途限制而非编译上的永久约束。
	depends on KASAN
	default KASAN_GENERIC || KASAN_SW_TAGS
	help
	  Make SLAB_TYPESAFE_BY_RCU caches behave approximately as if the cache
	  was not marked as SLAB_TYPESAFE_BY_RCU and every caller used
	  kfree_rcu() instead.

	  This is intended for use in combination with KASAN, to enable KASAN to
	  detect use-after-free accesses in such caches.
	  (KFENCE is able to do that independent of this flag.)

	  This might degrade performance.
	  Unfortunately this also prevents a very specific bug pattern from
	  triggering (insufficient checks against an object being recycled
	  within the RCU grace period); so this option can be turned off even on
	  KASAN builds, in case you want to test for such a bug.

	  If you're using this for testing bugs / fuzzing and care about
	  catching all the bugs WAY more than performance, you might want to
	  also turn on CONFIG_RCU_STRICT_GRACE_PERIOD.

	  WARNING:
	  This is designed as a debugging feature, not a security feature.
	  Objects are sometimes recycled without RCU delay under memory pressure.

	  If unsure, say N.

config PAGE_OWNER
# 记录每页最后分配调用栈，帮助定位裸 alloc_pages 泄漏；编译后仍需 page_owner=on
# 才分配/维护主要数据，运行开销和内存占用较高。
	bool "Track page owner"
	depends on DEBUG_KERNEL && STACKTRACE_SUPPORT
	select DEBUG_FS
	select STACKTRACE
	select STACKDEPOT
	select PAGE_EXTENSION
	help
	  This keeps track of what call chain is the owner of a page, may
	  help to find bare alloc_page(s) leaks. Even if you include this
	  feature on your build, it is disabled in default. You should pass
	  "page_owner=on" to boot parameter in order to enable it. Eats
	  a fair amount of memory if enabled. See tools/mm/page_owner_sort.c
	  for user-space helper.

	  If unsure, say N.

config PAGE_TABLE_CHECK
# 在用户页表项安装/移除时同步验证匿名页重复可写映射及匿名/文件页混用；选择
# PAGE_EXTENSION 保存状态，并要求 exclusive System RAM 边界可靠。
	bool "Check for invalid mappings in user page tables"
	depends on ARCH_SUPPORTS_PAGE_TABLE_CHECK
	depends on EXCLUSIVE_SYSTEM_RAM
	select PAGE_EXTENSION
	help
	  Check that anonymous page is not being mapped twice with read write
	  permissions. Check that anonymous and file pages are not being
	  erroneously shared. Since the checking is performed at the time
	  entries are added and removed to user page tables, leaking, corruption
	  and double mapping problems are detected synchronously.

	  If unsure say "n".

config PAGE_TABLE_CHECK_ENFORCED
# 强制页表检查默认开启，阻止仅因忘记 page_table_check=on 而漏测；仍依赖上项。
	bool "Enforce the page table checking by default"
	depends on PAGE_TABLE_CHECK
	help
	  Always enable page table checking.  By default the page table checking
	  is disabled, and can be optionally enabled via page_table_check=on
	  kernel parameter. This config enforces that page table check is always
	  enabled.

	  If unsure say "n".

config PAGE_POISONING
# free_pages 后写软件 poison，alloc_pages 前核对，既暴露 UAF 写入也降低旧数据
# 泄漏；它不同于硬件 HWPoison，若只需清零可用 init_on_free=1。
	bool "Poison pages after freeing"
	help
	  Fill the pages with poison patterns after free_pages() and verify
	  the patterns before alloc_pages. The filling of the memory helps
	  reduce the risk of information leaks from freed data. This does
	  have a potential performance impact if enabled with the
	  "page_poison=1" kernel boot option.

	  Note that "poison" here is not the same thing as the "HWPoison"
	  for CONFIG_MEMORY_FAILURE. This is software poisoning only.

	  If you are only interested in sanitization of freed pages without
	  checking the poison pattern on alloc, you can boot the kernel with
	  "init_on_free=1" instead of enabling this.

	  If unsure, say N

config DEBUG_PAGE_REF
# 为 page 引用增减加入 tracepoint，诊断迁移因引用不匹配失败；只有启用 tracepoint
# 时才有主要运行开销，但会增加约 30KB 代码。
	bool "Enable tracepoint to track down page reference manipulation"
	depends on DEBUG_KERNEL
	depends on TRACEPOINTS
	help
	  This is a feature to add tracepoint for tracking down page reference
	  manipulation. This tracking is useful to diagnose functional failure
	  due to migration failures caused by page reference mismatches.  Be
	  careful when enabling this feature because it adds about 30 KB to the
	  kernel code.  However the runtime performance overhead is virtually
	  nil until the tracepoints are actually enabled.

config DEBUG_RODATA_TEST
# 启动时验证 rodata 确实转为只读，仅在严格 W^X 基础能力存在时有意义。
	bool "Testcase for the marking rodata read-only"
	depends on STRICT_KERNEL_RWX
	help
	  This option enables a testcase for the setting rodata read-only.

config ARCH_HAS_DEBUG_WX
# 架构声明能遍历并判定内核映射的 W/X 属性。
	bool

config DEBUG_WX
# 启动后用 PTDUMP 检查残留 W+X 映射并告警；这是一次性防护审计，告警表示
# 利用面扩大，不等同于已经存在可直接利用漏洞。
	bool "Warn on W+X mappings at boot"
	depends on ARCH_HAS_DEBUG_WX
	depends on ARCH_HAS_PTDUMP
	depends on MMU
	select PTDUMP
	help
	  Generate a warning if any W+X mappings are found at boot.

	  This is useful for discovering cases where the kernel is leaving W+X
	  mappings after applying NX, as such mappings are a security risk.

	  Look for a message in dmesg output like this:

	    <arch>/mm: Checked W+X mappings: passed, no W+X pages found.

	  or like this, if the check failed:

	    <arch>/mm: Checked W+X mappings: failed, <N> W+X pages found.

	  Note that even if the check fails, your kernel is possibly
	  still fine, as W+X mappings are not a security hole in
	  themselves, what they do is that they make the exploitation
	  of other unfixed kernel bugs easier.

	  There is no runtime or memory usage effect of this option
	  once the kernel has booted up - it's a one time check.

	  If in doubt, say "Y".

config ARCH_HAS_PTDUMP
# 架构实现页表布局遍历/打印后选择此能力。
	bool

config PTDUMP
# 通用页表转储核心，由 DEBUG_WX 或用户可见 debugfs 前端选择。
	bool

config PTDUMP_DEBUGFS
# 把内核页表布局暴露给 debugfs，适合架构开发；生产系统会增加敏感布局可见性。
	bool "Export kernel pagetable layout to userspace via debugfs"
	depends on DEBUG_KERNEL
	depends on DEBUG_FS
	depends on ARCH_HAS_PTDUMP
	select PTDUMP
	help
	  Say Y here if you want to show the kernel pagetable layout in a
	  debugfs file. This information is only useful for kernel developers
	  who are working in architecture specific areas of the kernel.
	  It is probably not a good idea to enable this feature in a production
	  kernel.

	  If in doubt, say N.

config HAVE_DEBUG_KMEMLEAK
# 架构声明 kmemleak 扫描所需地址/内存模型支持。
	bool

config DEBUG_KMEMLEAK
# 类似保守 GC 地跟踪分配并扫描可达指针，但只报告孤儿对象、不自动释放；选择
# debugfs、符号、CRC、栈仓库等报告基础，所有分配路径会承担记录开销。
	bool "Kernel memory leak detector"
	depends on DEBUG_KERNEL && HAVE_DEBUG_KMEMLEAK
	select DEBUG_FS
	select STACKTRACE if STACKTRACE_SUPPORT
	select KALLSYMS
	select CRC32
	select STACKDEPOT
	select STACKDEPOT_ALWAYS_INIT if !DEBUG_KMEMLEAK_DEFAULT_OFF
	help
	  Say Y here if you want to enable the memory leak
	  detector. The memory allocation/freeing is traced in a way
	  similar to the Boehm's conservative garbage collector, the
	  difference being that the orphan objects are not freed but
	  only shown in /sys/kernel/debug/kmemleak. Enabling this
	  feature will introduce an overhead to memory
	  allocations. See Documentation/dev-tools/kmemleak.rst for more
	  details.

	  Enabling SLUB_DEBUG may increase the chances of finding leaks
	  due to the slab objects poisoning.

	  In order to access the kmemleak file, debugfs needs to be
	  mounted (usually at /sys/kernel/debug).

config DEBUG_KMEMLEAK_MEM_POOL_SIZE
# kmemleak 完成 slab 初始化前用静态元数据池记录早期分配，之后该池作为 slab
# 失败时的应急储备；过小会丢记录并制造假阳性，范围 200..1,000,000。
	int "Kmemleak memory pool size"
	depends on DEBUG_KMEMLEAK
	range 200 1000000
	default 16000
	help
	  Kmemleak must track all the memory allocations to avoid
	  reporting false positives. Since memory may be allocated or
	  freed before kmemleak is fully initialised, use a static pool
	  of metadata objects to track such callbacks. After kmemleak is
	  fully initialised, this memory pool acts as an emergency one
	  if slab allocations fail.

config DEBUG_KMEMLEAK_DEFAULT_OFF
# 编译检测器但默认不启动，需 kmemleak=on；适合保留诊断能力而控制普通启动开销。
	bool "Default kmemleak to off"
	depends on DEBUG_KMEMLEAK
	help
	  Say Y here to disable kmemleak by default. It can then be enabled
	  on the command line via kmemleak=on.

config DEBUG_KMEMLEAK_AUTO_SCAN
# 启动自动扫描线程并周期报告；扫描可能耗 CPU/阻塞用户任务，关闭后仍可手工
# 触发，但不会自动发现和报告新泄漏。
	bool "Enable kmemleak auto scan thread on boot up"
	default y
	depends on DEBUG_KMEMLEAK
	help
	  Depending on the cpu, kmemleak scan may be cpu intensive and can
	  stall user tasks at times. This option enables/disables automatic
	  kmemleak scan at boot up.

	  Say N here to disable kmemleak auto scan thread to stop automatic
	  scanning. Disabling this option disables automatic reporting of
	  memory leaks.

	  If unsure, say Y.

config DEBUG_KMEMLEAK_VERBOSE
# 自动扫描发现新孤儿对象时把回溯、十六进制内容和地址写入 dmesg；依赖自动
# 扫描，并可用 sysfs 模块参数动态切换，注意日志量和地址信息暴露。
	bool "Default kmemleak to verbose mode"
	depends on DEBUG_KMEMLEAK_AUTO_SCAN
	help
	  Say Y here to have kmemleak print unreferenced object details
	  (backtrace, hex dump, address) to dmesg when new memory leaks are
	  detected during automatic scanning. This can also be toggled at
	  runtime via /sys/module/kmemleak/parameters/verbose.

	  If unsure, say N.

config PER_VMA_LOCK_STATS
# 统计 per-VMA fault 快路径的成功、重试和失败并导出 /proc/vmstat，用于判断锁
# 粒度收益和退化场景；每次 fault 都增加计数，故有小幅热路径成本。
	bool "Statistics for per-vma locks"
	depends on PER_VMA_LOCK
	help
	  Say Y here to enable success, retry and failure counters of page
	  faults handled under protection of per-vma locks. When enabled, the
	  counters are exposed in /proc/vmstat. This information is useful for
	  kernel developers to evaluate effectiveness of per-vma locks and to
	  identify pathological cases. Counting these events introduces a small
	  overhead in the page fault path.

	  If in doubt, say N.
```
